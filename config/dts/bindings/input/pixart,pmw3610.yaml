## config/dts/bindings/input/pixart,pmw3610.yaml
```yaml
compatible: "pixart,pmw3610"
description: PixArt PMW3610 Optical Sensor

include: spi-device.yaml

properties:
  irq-gpios:
    type: phandle-array
    description: Interrupt GPIO

  motion-gpios:
    type: phandle-array
    description: Motion GPIO

  zephyr,axis-x:
    type: int
    required: true

  zephyr,axis-y:
    type: int
    required: true

  scroll-layers:
    type: array
    description: Layers used for scrolling
```

## config/west.yml
```yaml
manifest:
  remotes:
    - name: zmkfirmware
#      url-base: https://github.com/petejohanson
      url-base: https://github.com/josealvarez 
    - name: inorichi
      url-base: https://github.com/inorichi
  projects:
    - name: zmk
      remote: zmkfirmware
# 　　　revision: feat/pointers-move-scroll
　　　revision: main
      import: app/west.yml
    - name: zmk-pmw3610-driver
      remote: inorichi
      revision: main
  self:
    path: config
```
